## board/freescale/p1020_wlan/Kconfig
```kconfig
if TARGET_P1020WLAN

config SYS_BOARD
	default "p1020_wlan"

config SYS_VENDOR
	default "freescale"

config SYS_CONFIG_NAME
	default "p1020_wlan"

endif
```
